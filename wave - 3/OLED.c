#include "Delay.h"
#include "OLED.h"
code unsigned char OLED_F8x16[][16] = {


	
	0x00,0x00,0x00,0x00,0x00,0x00,0x00,0x00,
	0x00,0x00,0x00,0x00,0x00,0x00,0x00,0x00,//   0
	0x00,0x00,0x00,0xF8,0x00,0x00,0x00,0x00,
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	0x00,0x00,0x00,0x00,0x00,0x01,0x01,0x00,// ~ 94
};
	code unsigned char OLED_F6x8[][6] = 
{
	0x00,0x00,0x00,0x00,0x00,0x00,//   0
	0x00,0x00,0x00,0x2F,0x00,0x00,// ! 1
	0x00,0x00,0x07,0x00,0x07,0x00,// " 2
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	0x00,0x08,0x04,0x08,0x10,0x08,// ~ 94
};
void OLED_WriteCommand(unsigned char Command)
{
	unsigned char len;
	OLED_DC = 0;
	OLED_CS = 0;
	for(len=0;len<8;len++)
	{
		OLED_SCL = 0;
		if(Command&0x80)
		{OLED_SDIN = 1;	}	
		else
		{OLED_SDIN = 0;}
		OLED_SCL = 1;
		Command <<= 1;
	}
	OLED_CS = 1;
	OLED_DC = 1;
}
void OLED_WriteData(unsigned char Data)
{
	unsigned char len;
		OLED_DC = 1;
	OLED_CS = 0;
	for(len=0;len<8;len++)
	{
		OLED_SCL = 0;
		if(Data&0x80)
		{OLED_SDIN = 1;}
		else
		{OLED_SDIN = 0;}
		OLED_SCL = 1;
		Data <<= 1;
	}
	OLED_CS = 1;
	OLED_DC = 1;
}

void OLED_Init()
{
	OLED_RST = 0;
	Delay(200);
	OLED_RST = 1; 
	OLED_WriteCommand(0xAE);
	OLED_WriteCommand(0xD5);
	OLED_WriteCommand(0x80);
	OLED_WriteCommand(0xA8);
	OLED_WriteCommand(0x3F);
	OLED_WriteCommand(0xD3);
	OLED_WriteCommand(0x00);
	OLED_WriteCommand(0x40);
	OLED_WriteCommand(0xA1);
	OLED_WriteCommand(0xC8);
	OLED_WriteCommand(0xDA);
	OLED_WriteCommand(0x12);
	OLED_WriteCommand(0x81);
	OLED_WriteCommand(0xCF);
	OLED_WriteCommand(0xD9);
	OLED_WriteCommand(0xF1);
	OLED_WriteCommand(0xDB);
	OLED_WriteCommand(0x30);
	OLED_WriteCommand(0xA4);
	OLED_WriteCommand(0xA6);
	OLED_WriteCommand(0x8D);
	OLED_WriteCommand(0x14);
	OLED_WriteCommand(0xAF);
	Delay(100);
}
void OLED_SetCursor(unsigned char X,unsigned char Page)
{
	OLED_WriteCommand(0x00|(X&0x0F));
	OLED_WriteCommand(0x10|(X&0xF0)>>4);
	OLED_WriteCommand(0xB0|Page);
}
	void OLED_Clear(){
	unsigned char i,j;
	for(i=0;i<8;i++){
	OLED_SetCursor(0,i);
	for(j=0;j<128;j++){
	OLED_WriteData(0x00);}
	}
}
	void OLED_Clear_Row(int Row)
	{
		unsigned char i;
		OLED_SetCursor(0,Row);
		for(i=0;i<128;i++)
		{
		OLED_WriteData(0x00);
		}
	}
		void OLED_Axis_X()
	{
	unsigned char i;
		OLED_SetCursor(1,4);
		for(i=1;i<128;i++)
		{
		OLED_WriteData(0x80);
		}
	}
	void OLED_Axis_Y()
	{
	unsigned char i;
		for(i=2;i<8;i++)
		{
		OLED_SetCursor(0,i);
		OLED_WriteData(0xFF);
		}
	}
	void OLED_ShowChar(unsigned char X,unsigned char Page,unsigned char Char,unsigned char FrontSize)
{
	unsigned char i;
	if(FrontSize==6){
	OLED_SetCursor(X,Page);
	for(i=0;i<6;i++){
	OLED_WriteData( OLED_F6x8[Char-' '][i]);}
}
	if(FrontSize==8){		
	OLED_SetCursor(X,Page);
	for(i=0;i<8;i++){
	OLED_WriteData( OLED_F8x16[Char-' '][i]);
	}
	OLED_SetCursor(X,Page+1);
	for(i=0;i<8;i++){
	OLED_WriteData( OLED_F8x16[Char-' '][i+8]);
	}
}
}
void OLED_ShowString(unsigned char X,unsigned char Page,unsigned char *String,unsigned char FrontSize)
{
	unsigned char m;
	for(m=0;String[m]!='\0';m++)
	{
	OLED_ShowChar( X+m*FrontSize,Page,String[m],FrontSize);
	}
}
 int OLED_Pow(int X, int Y)
{
	int Result = 1;
	while (Y--)
	{
		Result *= X;
	}
	return Result;
}

void OLED_ShowNum(unsigned char X,unsigned char Page,int Num,unsigned int Length,unsigned char FrontSize)
{
	int i;
	for (i=0;i<Length;i++)							
	{if(Num>=0){
		OLED_ShowChar(X+FrontSize*i, Page, Num/OLED_Pow(10,Length-i-1)%10+'0',FrontSize);
	}
	else{
	OLED_ShowChar(X-FrontSize, Page,'-',FrontSize);
	OLED_ShowChar(X+FrontSize*i, Page, -Num/OLED_Pow(10,Length-i-1)%10+'0',FrontSize);
	}
}
}
void Show(int j)
{	int k,l;
	for(k=0;k<j+1;k++){
			OLED_ShowString(116,k,"  ",6);
	}
	for(l=j+2;l<9;l++){
	OLED_ShowString(116,l,"  ",6);
}
	OLED_ShowString(116,j+1,"<<",6);
	}
void ClearGraph()
{
	unsigned char i,j;
	for(i=2;i<7;i++){
	OLED_SetCursor(1,i);
	for(j=2;j<129;j++){
	OLED_WriteData(0x00);}
	}
	OLED_SetCursor(1,7);
	for(j=2;j<129;j++){
	OLED_WriteData(0x80);}
}
void oled_Draw_szLine2(unsigned char x,unsigned char start,unsigned char end)
{
	unsigned char i,index=0,number,ed=63-start,st=63-end;
	for(i=0;i<8;i++)
	{
		number=255;
		if(st>=index&&st<index+8)
		{
			number>>=(st-index);
			number<<=(st-index);
		}
		if(ed>=index&&ed<index+8)
		{
			number<<=(index+7-ed);
			number>>=(index+7-ed);
		}
		else if(st>=index+8||ed<=index)
		{
			number=0;
		}
		OLED_SetCursor(x,i);
		OLED_WriteData(number);
		index+=8;
	}
}